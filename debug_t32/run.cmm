;
; Copyright 2024-2025 NXP
;
; NXP Confidential and Proprietary. 
; This software is owned or controlled by NXP and may only be used strictly
; in accordance with the applicable license terms.  By expressly accepting
; such terms or by downloading, installing, activating and/or otherwise using
; the software, you are agreeing that you have read, and that you agree to
; comply with and are bound by, such license terms.  If you do not agree to
; be bound by the applicable license terms, then you may not retain,
; install, activate or otherwise use the software.

LOCAL &load_to
LOCAL &elf_file
LOCAL &core_no
;LOCAL &load_params
;LOCAL &multicore
;LOCAL &core_list
;LOCAL &hse_available

&load_to="flash"                                                                                ;target memory: flash or ram
&elf_file="../Debug_FLASH/FreeRTOS_Toggle_Led_Example_S32K312.elf"        						;path to elf file
&core_no="0"                                                        	                        ;select core(0,2)

DO s32k312.cmm &load_to &elf_file &load_params &core_no &multicore &core_list

data.list
register.set pc Reset_Handler
go main
TASK.CONFIG ~~/demo/arm/kernel/freertos/freertos.t32